## CMakeLists.txt
```
cmake_minimum_required(VERSION 3.20.0)

find_package(Zephyr REQUIRED HINTS $ENV{ZEPHYR_BASE})
project(audio_card_2)

target_sources(app
    PRIVATE
        src/main.c
        src/blink.c
)
```

## prj.conf
```kconfig
CONFIG_BOOT_BANNER=y

CONFIG_USB_DEVICE_STACK=y
CONFIG_USB_DEVICE_PRODUCT="Zephyr USB console sample"
CONFIG_USB_DEVICE_PID=0x0004
CONFIG_USB_DEVICE_INITIALIZE_AT_BOOT=n
#CONFIG_USB_DEVICE_AUDIO=y

CONFIG_SERIAL=y
CONFIG_CONSOLE=y
CONFIG_UART_CONSOLE=y
CONFIG_UART_LINE_CTRL=y

CONFIG_SHELL=y
CONFIG_SHELL_BACKEND_SERIAL=y

CONFIG_PRINTK=y

CONFIG_LOG=y
CONFIG_USB_DRIVER_LOG_LEVEL_ERR=y
CONFIG_USB_DEVICE_LOG_LEVEL_ERR=y

CONFIG_GPIO=y
#
#CONFIG_AUDIO=y
#CONFIG_AUDIO_CODEC=y
#CONFIG_AUDIO_CODEC_CS43L22=y
#CONFIG_SAMPLE_FREQ=8000
#
#CONFIG_I2S=y
#CONFIG_I2S_STM32=y
#
#CONFIG_NET_BUF=y
```

## boards/stm32f4_disco.overlay
```dts
/ {
	aliases {
		ledg = &green_led_4;
		ledo = &orange_led_3;
		ledr = &red_led_5;
		ledb = &blue_led_6;
	};
};
```

## src/main.c
```c
#include <stdio.h>
#include <zephyr/device.h>
#include <zephyr/kernel.h>
#include <zephyr/devicetree.h>
#include <zephyr/sys/printk.h>
#include <zephyr/audio/codec.h>
#include <zephyr/logging/log.h>
#include <zephyr/drivers/i2s.h>
#include <zephyr/drivers/uart.h>
#include <zephyr/drivers/gpio.h>
#include <zephyr/usb/usb_device.h>
#include <zephyr/usb/class/usb_audio.h>

LOG_MODULE_REGISTER(main, LOG_LEVEL_INF);



int main(void)
{
	if (usb_enable(NULL)) {
		LOG_ERR("Cannot enable USB!");
		return 0;
	}
	LOG_INF("USB enabled.");

	while(1) {
		k_msleep(1000);
	}
}
 
```
