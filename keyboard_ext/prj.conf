## CMakeLists.txt
```
# SPDX-License-Identifier: Apache-2.0

cmake_minimum_required(VERSION 3.20.0)
find_package(Zephyr REQUIRED HINTS $ENV{ZEPHYR_BASE})
project(keyboard_ext)

FILE(GLOB app_sources src/*.c)
target_sources(
    app 
    PRIVATE 
    src/app_usb.c
    src/app_inputs.c
    src/app_cli.c
    src/app_keyboard.c
    src/app_usb_keyboard.c
)
target_include_directories(
    app
    PRIVATE
    src
)
```

## Kconfig
```
# Copyright (c) 2023 Nordic Semiconductor ASA
# SPDX-License-Identifier: Apache-2.0

# Source common USB sample options used to initialize new experimental USB
# device stack. The scope of these options is limited to USB samples in project
# tree, you cannot use them in your own application.
source "Kconfig.zephyr"
```

## prj.conf
```kconfig
CONFIG_BOOT_BANNER=y

CONFIG_USB_DEVICE_STACK=y
CONFIG_USB_DEVICE_HID=y
CONFIG_USB_DEVICE_PRODUCT="keyboard-ext"
CONFIG_USB_DEVICE_PID=0x0007
CONFIG_USB_DEVICE_INITIALIZE_AT_BOOT=n

CONFIG_LOG=y
CONFIG_USB_DRIVER_LOG_LEVEL_ERR=y
CONFIG_USB_DEVICE_LOG_LEVEL_ERR=y

CONFIG_PRINTK=y
CONFIG_GPIO=y
CONFIG_INPUT=y
CONFIG_INPUT_MODE_SYNCHRONOUS=y

CONFIG_SHELL=y
CONFIG_SHELL_BACKEND_SERIAL=y
CONFIG_SERIAL=y
CONFIG_CONSOLE=y
CONFIG_UART_CONSOLE=y
CONFIG_UART_LINE_CTRL=y
```

## src/main.c
```c
#include <string.h>

#include <zephyr/kernel.h>
#include <zephyr/device.h>
#include <zephyr/drivers/gpio.h>
#include <zephyr/input/input.h>
#include <zephyr/sys/util.h>

#include <zephyr/usb/usb_device.h>
#include <zephyr/usb/usbd.h>
#include <zephyr/usb/class/usb_hid.h>

#include <zephyr/logging/log.h>
LOG_MODULE_REGISTER(main, LOG_LEVEL_INF);



int main(void)
{
    int ret = usb_enable(NULL);
    if (0 != ret) {
        LOG_ERR("Cannot init USB.");
        return 0;
    }

    while (true) {
        k_msleep(500);
    }

    return 0;
}
```

## src/app_cli.c
```c
#include <errno.h>
#include <stdlib.h>

#include <zephyr/kernel.h>
#include <zephyr/shell/shell.h>

#include "app_usb.h"
#include "app_keyboard.h"
#include "config.h"

static int key_simulation_argv_parser(const struct shell* sh, size_t argc, char** argv, uint32_t* key_code) 
{
    int rv = 0;

    do {
        if (argc < 2) {
            shell_error(sh, "Usage: press <key code>");
            rv = -EINVAL;
            break;
        }

        *key_code = 0;

        char *endptr = NULL;
        errno = 0;
        size_t argv_len = strlen(argv[1]);
        uint32_t key_code_local = strtol(argv[1], &endptr, 10);

        if (0 != errno) {
            shell_error(sh, "Invalid string.");
            rv = errno;
            break;
        } 
        if (endptr == argv[1]) {
            shell_error(sh, "No digits found.");
            rv = -EINVAL;
            break;
        }
        if ((argv[1] + argv_len) != endptr) {
            shell_error(sh, "Not whole string processed");
            rv = -EINVAL;
            break;
        }
        
        *key_code = key_code_local;
    } while(false);

    return rv;
}

static int cmd_press(const struct shell *sh, size_t argc, char **argv)
{
    uint32_t key_code;
    int rv = 0;

    do
    {
        rv = key_simulation_argv_parser(sh, argc, argv, &key_code);
        if (0 != rv) {
            break;
        }

     	rv = app_keyboard_report_key_press(key_code, true, K_MSEC(500));  
        app_usb_report_key_press();
    } while(false);

    return rv;
}

static int cmd_release(const struct shell *sh, size_t argc, char **argv)
{
    uint32_t key_code;
    int rv = 0;

    do
    {
        rv = key_simulation_argv_parser(sh, argc, argv, &key_code);
        if (0 != rv) {
            break;
        }

	rv = app_keyboard_report_key_press(key_code, false, K_MSEC(500));        
	app_usb_report_key_press();
    } while(false);

    return rv;
}

static int cmd_click(const struct shell *sh, size_t argc, char **argv)
{
    uint32_t key_code;
    int rv = 0;

    do
    {
        rv = key_simulation_argv_parser(sh, argc, argv, &key_code);
        if (0 != rv) {
            break;
        }

	rv = app_keyboard_report_key_press(key_code, true, K_MSEC(500));        
	app_usb_report_key_press();
        if (0 != rv) {
            break;
        }

        k_sleep(K_MSEC(CONFIG_APP_CLI_CLICK_TIME));

	rv = app_keyboard_report_key_press(key_code, false, K_MSEC(500));        
	app_usb_report_key_press();
        if (0 != rv) {
            break;
        }
    } while(false);

    return rv;
}

static int cmd_print_descriptor(const struct shell *sh, size_t argc, char **argv)
{
    app_usb_print_descriptor();
    return 0;
}


static int cmd_play_pause(const struct shell *sh, size_t argc, char **argv)
{
    app_usb_play_pause();
    return 0;
}

static int cmd_volume_up(const struct shell *sh, size_t argc, char **argv)
{
    app_usb_volume_up();
    return 0;
}

static int cmd_volume_down(const struct shell *sh, size_t argc, char **argv)
{
    app_usb_volume_down();
    return 0;
}

static int cmd_mute(const struct shell *sh, size_t argc, char **argv)
{
    app_usb_mute();
    return 0;
}



SHELL_STATIC_SUBCMD_SET_CREATE(sub_app,
        SHELL_CMD_ARG(press, NULL, "Simulate press.", cmd_press, 1, 1),
        SHELL_CMD_ARG(release, NULL, "Simulate release", cmd_release, 1, 1),
        SHELL_CMD_ARG(click, NULL, "Simulate click", cmd_click, 1, 1),
        SHELL_CMD(descriptor, NULL, "USB descriptor", cmd_print_descriptor),
        SHELL_CMD(play_pause, NULL, "USB descriptor", cmd_play_pause),
        SHELL_CMD(volume_up, NULL, "USB descriptor", cmd_volume_up),
        SHELL_CMD(volume_down, NULL, "USB descriptor", cmd_volume_down),
        SHELL_CMD(mute, NULL, "USB descriptor", cmd_mute),
        SHELL_SUBCMD_SET_END
);

SHELL_CMD_REGISTER(app, &sub_app, "Application commands", NULL);
```

## src/app_inputs.c
```c
#include <string.h>

#include <zephyr/kernel.h>
#include <zephyr/device.h>
#include <zephyr/drivers/gpio.h>
#include <zephyr/input/input.h>
#include <zephyr/sys/util.h>

#include <zephyr/usb/usb_device.h>
#include <zephyr/usb/usbd.h>
#include <zephyr/usb/class/usb_hid.h>

#include <zephyr/logging/log.h>
LOG_MODULE_REGISTER(app_inputs, LOG_LEVEL_INF);


static void input_cb(struct input_event *evt, void *user_data)
{
	ARG_UNUSED(user_data);

    LOG_INF("input_cb: evt->code: %d, evt->value: %d", evt->code, evt->value);

}

/*  This callback function will handle all system inputs.
 */
INPUT_CALLBACK_DEFINE(NULL, input_cb, NULL);
```

## src/app_keyboard.c
```c
#include "config.h"

#include <assert.h>
#include <zephyr/kernel.h>
#include <zephyr/sys/slist.h>

struct pressed_key {
    sys_snode_t _header;
    uint32_t code;
};

K_MEM_SLAB_DEFINE(
    pressed_keys_list_mem, 
    sizeof(struct pressed_key), 
    CONFIG_APP_MAX_KEYS_REPORTED, 
    4
);

static sys_slist_t pressed_keys_list_hnd = SYS_SLIST_STATIC_INIT(pressed_keys_list_hnd);

K_MUTEX_DEFINE(mutex);

static bool is_list_full(void)
{
    return CONFIG_APP_MAX_KEYS_REPORTED == sys_slist_len(&pressed_keys_list_hnd);
}

static int add_key_to_list(uint32_t code, k_timeout_t timeout)
{
    int rv = 0;

    do {

        size_t n_keys_in_list = sys_slist_len(&pressed_keys_list_hnd);
        if (CONFIG_APP_MAX_KEYS_REPORTED <= n_keys_in_list) {
            rv = -ENOMEM;
            break;
        }

        struct pressed_key* chunk = NULL;
        rv = k_mem_slab_alloc(
            &pressed_keys_list_mem,
            (void**)&chunk,
            timeout
        );
        if (0 != rv) {
            break;
        }

        chunk->code = code;

        sys_slist_append(&pressed_keys_list_hnd, &(chunk->_header));


    } while(false);

    return rv;
}

static int remove_key_from_list(uint32_t code)
{
    int rv = 0;

    do {
        struct pressed_key* chunk;
        sys_snode_t* header;
        struct pressed_key* chunk_to_remove = NULL;

        SYS_SLIST_FOR_EACH_NODE(&pressed_keys_list_hnd, header) {
            chunk = CONTAINER_OF(header, struct pressed_key, _header);
            if (code == chunk->code) {
                chunk_to_remove = chunk;
                break;
            }
        }

        if (NULL != chunk_to_remove) {
            rv = (true == sys_slist_find_and_remove(
                &pressed_keys_list_hnd,
                &(chunk_to_remove->_header)
            )) ? 0 : -EIO;

            if (0 != rv) {
                break;
            }

            k_mem_slab_free(
                &pressed_keys_list_mem,
                chunk_to_remove
            );
        }

    } while (false);

    return rv;    
}

static int remove_oldest_key_from_list(void)
{
    sys_snode_t* header = sys_slist_get(&pressed_keys_list_hnd);
    struct pressed_key* chunk = CONTAINER_OF(header, struct pressed_key, _header);
    k_mem_slab_free(
        &pressed_keys_list_mem,
        chunk
    );
    return 0;
}

static bool is_key_in_list(uint32_t code)
{
    sys_snode_t* header;

    SYS_SLIST_FOR_EACH_NODE(&pressed_keys_list_hnd, header) {
         struct pressed_key* chunk = CONTAINER_OF(header, struct pressed_key, _header);
        if (code == chunk->code) {
            return true;
        }
    }

    return false;
}


int app_keyboard_report_key_press(uint32_t code, bool is_pressed, k_timeout_t timeout)
{
    int rv = 0;

    rv = k_mutex_lock(&mutex, timeout);
    if (0 != rv) {
        return rv;
    }

    do {

        if (is_pressed) {
            if (false == is_key_in_list(code)) {
                if (is_list_full()) {
                    rv = remove_oldest_key_from_list();
                    if (0 != rv) {
                        break;
                    }
                }
                rv = add_key_to_list(code, timeout);
            }
        }
        else
        {
            rv = remove_key_from_list(code);
            assert(-EIO != rv);
        }

        

    } while (false);

    k_mutex_unlock(&mutex);

    return rv;
}

int app_keyboard_get_pressed(uint32_t codes[CONFIG_APP_MAX_KEYS_REPORTED], size_t* len, k_timeout_t timeout)
{
    int rv = 0;
    assert(len);

    do {
        size_t index = 0;
        *len = 0;

        rv = k_mutex_lock(&mutex, timeout);
        if (0 != rv) {
            break;
        }

        sys_snode_t* header;
        SYS_SLIST_FOR_EACH_NODE(&pressed_keys_list_hnd, header) {
            struct pressed_key* chunk = CONTAINER_OF(header, struct pressed_key, _header);
            assert(index < CONFIG_APP_MAX_KEYS_REPORTED);
            codes[index] = chunk->code;
            index++;
        }
        *len = index;

        k_mutex_unlock(&mutex);

    } while (false);

    return rv;
}
```

## src/app_keyboard.h
```c
#ifndef _APP_KEYBOARD_H_
#define _APP_KEYBOARD_H_

#include <zephyr/kernel.h>

#include "config.h"

int app_keyboard_report_key_press(uint32_t code, bool is_pressed, k_timeout_t timeout);
int app_keyboard_get_pressed(uint32_t codes[CONFIG_APP_MAX_KEYS_REPORTED], size_t* len, k_timeout_t timeout);

#endif
```

## src/app_usb.c
```c
#include <string.h>

#include <zephyr/kernel.h>
#include <zephyr/device.h>
#include <zephyr/drivers/gpio.h>
#include <zephyr/input/input.h>
#include <zephyr/sys/util.h>

#include <zephyr/usb/usb_device.h>
#include <zephyr/usb/usbd.h>
#include <zephyr/usb/class/usb_hid.h>

#include "config.h"
#include "app_keyboard.h"
#include "app_usb_keyboard.h"

#include <zephyr/logging/log.h>
LOG_MODULE_REGISTER(app_usb, LOG_LEVEL_INF);

// https://www.usb.org/sites/default/files/documents/hut1_12v2.pdf
// https://notes.iopush.net/blog/2016/custom-usb-hid-device-descriptor-media-keyboard/
// https://www.silabs.com/documents/public/application-notes/AN249.pdf?utm_source=chatgpt.com 

#define PLAY_PAUSE          0xCD
#define VOLUME_UP           0xE9
#define VOLUME_DOWN         0xEA
#define MUTE                0xE2

#define HID_CUSTOM_REPORT_DESC() {				    \
	HID_USAGE_PAGE(0x0C),			                \
	HID_USAGE(0x01),		                        \
    HID_COLLECTION(HID_COLLECTION_APPLICATION),		\
        HID_LOGICAL_MIN8(0),                        \
        HID_LOGICAL_MAX8(1),                        \
        HID_USAGE(PLAY_PAUSE),                      \       
        HID_USAGE(VOLUME_UP),                       \       
        HID_USAGE(VOLUME_DOWN),                     \      
        HID_USAGE(MUTE),                            \      
        HID_REPORT_SIZE(1),                         \
        HID_REPORT_COUNT(3),                        \
        HID_INPUT(0x02),                            \
        HID_REPORT_SIZE(5),                         \
        HID_REPORT_COUNT(1),                        \
        HID_INPUT(0x03),                            \
    HID_END_COLLECTION,                             \
}

//static const uint8_t hid_report_desc[] = HID_KEYBOARD_REPORT_DESC();
static const uint8_t hid_report_desc[] = HID_CUSTOM_REPORT_DESC();
static enum usb_dc_status_code usb_status;

static const struct device* hid_dev = NULL;

static K_SEM_DEFINE(ep_write_sem, 0, 1);
static K_SEM_DEFINE(new_keyboard_state, 1, 1);

static inline void status_cb(enum usb_dc_status_code status, const uint8_t *param)
{
	usb_status = status;
}

static void int_in_ready_cb(const struct device *dev)
{
	ARG_UNUSED(dev);
	k_sem_give(&ep_write_sem);
}

static const struct hid_ops ops = {
	.int_in_ready = int_in_ready_cb,
};


void app_usb_report_key_press(void)
{
    k_sem_give(&new_keyboard_state);
}

static int app_usb_get_key_press_evt(k_timeout_t timeout)
{
    return k_sem_take(&new_keyboard_state, timeout);
}


K_THREAD_STACK_DEFINE(app_usb_thread_stack, CONFIG_APP_USB_THREAD_STACK_SIZE);
struct k_thread app_usb_thread_data;

static void app_usb_thread(void*, void*, void*)
{

    while (true) {
        int rv = app_usb_get_key_press_evt(K_FOREVER);
        if (0 != rv) {
            continue;
        }

        //uint32_t keys_pressed[CONFIG_APP_MAX_KEYS_REPORTED] = {0};
        //size_t n_keys_pressed = 0;
        //rv = app_keyboard_get_pressed(keys_pressed, &n_keys_pressed, K_MSEC(0));

        //LOG_INF("Pressed keys:");
        //for (size_t i = 0; i < n_keys_pressed; i++) {
        //    LOG_INF("\t%d: 0x%08x", i, keys_pressed[i]);
        //}
        //LOG_INF("\n");
        
        UDC_STATIC_BUF_DEFINE(report, APP_USB_KEYBOARD_PACKET_SIZE);

        app_usb_keyboard_generate_packet((struct usb_hid_packet*)report);

        rv = hid_int_ep_write(hid_dev, report, APP_USB_KEYBOARD_PACKET_SIZE, NULL);
        if (0 == rv) {
            k_sem_take(&ep_write_sem, K_FOREVER);
            LOG_INF("USB-HID keyboard report sent.");
        } else {
            LOG_ERR("USB-HID keyboard report sent error.");
        }
    }
}

static int init(void)
{
    int rv = 0;
    do
    {
        hid_dev = device_get_binding("HID_0");
	    if (hid_dev == NULL) {
	    	LOG_ERR("Cannot get USB HID Device");
	    	rv = -EIO;
            break;
	    }

	    usb_hid_register_device(hid_dev, hid_report_desc, 
            sizeof(hid_report_desc), &ops);
	    usb_hid_init(hid_dev);

        rv = usb_enable(status_cb);
        if (0 != rv) {
            LOG_ERR("Cannot init USB.");
            break;
        }

        k_tid_t tid = k_thread_create(&app_usb_thread_data, app_usb_thread_stack,
                        K_THREAD_STACK_SIZEOF(app_usb_thread_stack), app_usb_thread,
                        NULL, NULL, NULL, CONFIG_APP_USB_THREAD_PRIORITY, 0, 
                        K_MSEC(CONFIG_APP_USB_THREAD_START_DELAY));
        if (NULL == tid) {
            rv = -ENOMEM;
            break;
        }

    } while (false);

    return rv;
}

SYS_INIT_NAMED(APP_USB, init, APPLICATION, 0);

int app_usb_print_descriptor(void)
{
    LOG_HEXDUMP_INF(hid_report_desc, sizeof(hid_report_desc), "HID report descriptor");

    return 0;
}

int app_usb_play_pause(void)
{
    LOG_INF("PLAY/PAUSE");
    UDC_STATIC_BUF_DEFINE(report, 1);
    *((uint8_t*)(report)) = (0x1 << 0);
    LOG_INF("Report 0x%02x", *((uint8_t*)(report)));
    int rv = hid_int_ep_write(hid_dev, report, 1, NULL);
    if (0 == rv) {
        k_sem_take(&ep_write_sem, K_FOREVER);
        LOG_INF("USB-HID keyboard report sent.");
    } else {
        LOG_ERR("USB-HID keyboard report sent error.");
    }
    *((uint8_t*)(report)) = 0;
    LOG_INF("Report 0x%02x", *((uint8_t*)(report)));
    rv = hid_int_ep_write(hid_dev, report, 1, NULL);
    if (0 == rv) {
        k_sem_take(&ep_write_sem, K_FOREVER);
        LOG_INF("USB-HID keyboard report sent.");
    } else {
        LOG_ERR("USB-HID keyboard report sent error.");
    }
    return 0;
}

int app_usb_volume_up(void)
{
    LOG_INF("VOLUME UP");
    UDC_STATIC_BUF_DEFINE(report, 1);
    *((uint8_t*)(report)) = (0x1 << 1);
    LOG_INF("Report 0x%02x", *((uint8_t*)(report)));
    int rv = hid_int_ep_write(hid_dev, report, 1, NULL);
    if (0 == rv) {
        k_sem_take(&ep_write_sem, K_FOREVER);
        LOG_INF("USB-HID keyboard report sent.");
    } else {
        LOG_ERR("USB-HID keyboard report sent error.");
    }
    *((uint8_t*)(report)) = 0;
    LOG_INF("Report 0x%02x", *((uint8_t*)(report)));
    rv = hid_int_ep_write(hid_dev, report, 1, NULL);
    if (0 == rv) {
        k_sem_take(&ep_write_sem, K_FOREVER);
        LOG_INF("USB-HID keyboard report sent.");
    } else {
        LOG_ERR("USB-HID keyboard report sent error.");
    }
    return 0;
}

int app_usb_volume_down(void)
{
    LOG_INF("VOLUME DOWN");
    UDC_STATIC_BUF_DEFINE(report, 1);
    *((uint8_t*)(report)) = (0x1 << 2);
    LOG_INF("Report 0x%02x", *((uint8_t*)(report)));
    int rv = hid_int_ep_write(hid_dev, report, 1, NULL);
    if (0 == rv) {
        k_sem_take(&ep_write_sem, K_FOREVER);
        LOG_INF("USB-HID keyboard report sent.");
    } else {
        LOG_ERR("USB-HID keyboard report sent error.");
    }
    *((uint8_t*)(report)) = 0;
    LOG_INF("Report 0x%02x", *((uint8_t*)(report)));
    rv = hid_int_ep_write(hid_dev, report, 1, NULL);
    if (0 == rv) {
        k_sem_take(&ep_write_sem, K_FOREVER);
        LOG_INF("USB-HID keyboard report sent.");
    } else {
        LOG_ERR("USB-HID keyboard report sent error.");
    }
    return 0;
}

int app_usb_mute(void)
{
    LOG_INF("MUTE");
    UDC_STATIC_BUF_DEFINE(report, 1);
    *((uint8_t*)(report)) = (0x1 << 3);
    LOG_INF("Report 0x%02x", *((uint8_t*)(report)));
    int rv = hid_int_ep_write(hid_dev, report, 1, NULL);
    if (0 == rv) {
        k_sem_take(&ep_write_sem, K_FOREVER);
        LOG_INF("USB-HID keyboard report sent.");
    } else {
        LOG_ERR("USB-HID keyboard report sent error.");
    }
    *((uint8_t*)(report)) = 0;
    LOG_INF("Report 0x%02x", *((uint8_t*)(report)));
    rv = hid_int_ep_write(hid_dev, report, 1, NULL);
    if (0 == rv) {
        k_sem_take(&ep_write_sem, K_FOREVER);
        LOG_INF("USB-HID keyboard report sent.");
    } else {
        LOG_ERR("USB-HID keyboard report sent error.");
    }
    return 0;
}
```

## src/app_usb.h
```c
#ifndef _APP_USB_H_
#define _APP_USB_H_

#include <zephyr/kernel.h>

void app_usb_report_key_press(void);
int app_usb_print_descriptor(void);

int app_usb_play_pause(void);
int app_usb_volume_up(void);
int app_usb_volume_down(void);
int app_usb_mute(void);

#endif
```

## src/app_usb_keyboard.c
```c
#include <string.h>
#include <assert.h>
#include "app_usb_keyboard.h"
#include "app_keyboard.h"

int app_usb_keyboard_generate_packet(struct usb_hid_packet* packet)
{
    assert(packet);

    uint32_t key_codes[CONFIG_APP_MAX_KEYS_REPORTED];
    size_t n_key_codes = 0;

    int rv = 0;

    do {
        rv = app_keyboard_get_pressed(key_codes, &n_key_codes, K_MSEC(0));
        if (0 != rv) {
            break;
        }

        memset(packet, 0x00, sizeof(struct usb_hid_packet));

        for (size_t i = 0; ((i < CONFIG_APP_MAX_KEYS_REPORTED) && (i < n_key_codes)); i++) {
            packet->keycodes[i] = (uint8_t)(key_codes[i] & 0x000000FF);
        }
    } while(false);

    return rv;
}
```

## src/app_usb_keyboard.h
```c
#ifndef _APP_USB_KEYBOARD_H_
#define _APP_USB_KEYBOARD_H_

#include <stdint.h>
#include "config.h"

struct usb_hid_packet {
    uint8_t modifier;
    uint8_t reserved;
    uint8_t keycodes[CONFIG_APP_MAX_KEYS_REPORTED];
} __packed;

#define APP_USB_KEYBOARD_PACKET_SIZE        sizeof(struct usb_hid_packet)

int app_usb_keyboard_generate_packet(struct usb_hid_packet* packet);

#endif 
```

## src/config.h
```c
#ifndef _CONFIG_H_
#define _CONFIG_H_

#define CONFIG_APP_USB_THREAD_STACK_SIZE        (4096)
#define CONFIG_APP_USB_THREAD_PRIORITY          (5)
#define CONFIG_APP_USB_THREAD_START_DELAY       (1000)

#define CONFIG_APP_USB_REPORT_QUEUE_LEN         (10)

#define CONFIG_APP_CLI_CLICK_TIME               (100)

#define CONFIG_APP_MAX_KEYS_REPORTED            (6)         // do not modify this

#endif 
```
