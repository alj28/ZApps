## manifest/west.yml
```yaml
manifest:
  remotes: 
    - name: zephyrproject
      url-base: https://github.com/zephyrproject-rtos

  projects:
    - name: zephyr
      remote: zephyrproject
      revision: v4.1.0
      path: zephyr
      clone-depth: 1
      import:
        name-allowlist:
          - hal_stm32
          - cmsis
          - mbedtls
          - cmsis-dsp  

    #- name: cmsis-dsp
    #  remote: zephyrproject
    #  revision: main  # Or pin to a version like 1.14.0
    #  path: modules/hal/cmsis-dsp


  self:
    path: zephyr
```
